// SPDX-License-Identifier: BSD-3-Clause
/*
 * Samsung Galaxy Book4 Edge 15.6" (NP750XQA), Snapdragon X Plus X1P42100.
 *
 * Derived from the X1E80100 Galaxy Book4 Edge DTS. Board wiring follows this
 * machine's own DSDT: keyboard i2c0/0x05/GPIO67, touchpad i2c13/0x40/GPIO3,
 * EC event GPIO66, lid GPIO92, HDMI HPD GPIO126, WLAN enable GPIO117 + PCIe4
 * PERST GPIO146, BT enable GPIO116, Type-C orientation GPIO121/123, two USB-C
 * connectors, UFS storage.
 *
 * Panel power and backlight rails use the X1P reference wiring (edp regulator
 * on GPIO70, backlight rail pmc8380_3 gpio10, enable gpio4, PMK8550 PWM), taken
 * from x1p42100-lenovo-thinkbook-16.dts and verified on this board.
 *
 * Camera: ov02c10 on CCI0/0x36 behind CSIPHY0 (values from the Qualcomm AeoB
 * firmware profile of this machine). Audio: two WSA883x speakers on the WSA
 * bus, WCD9385 headset codec, four DMICs at 2.4 MHz.
 *
 * Copyright (c) 2023 Qualcomm Innovation Center, Inc. All rights reserved.
 * Copyright (c) 2025 Kirill A. Korinsky <kirill@korins.ky>
 * Copyright (c) 2025 Valentin Manea <valentin.manea@mrs.ro>
 * Copyright (c) 2025 Jens Glathe <jens.glathe@oldschoolsolutions.biz>
 */

/dts-v1/;

#include <dt-bindings/clock/qcom,x1e80100-camcc.h>
#include <dt-bindings/gpio/gpio.h>
#include <dt-bindings/input/gpio-keys.h>
#include <dt-bindings/input/input.h>
#include <dt-bindings/phy/phy.h>
#include <dt-bindings/pinctrl/qcom,pmic-gpio.h>
#include <dt-bindings/regulator/qcom,rpmh-regulator.h>
#include <dt-bindings/thermal/thermal.h>

#include "purwa.dtsi"
#include "hamoa-pmics.dtsi"

/ {
	model = "Samsung Galaxy Book4 Edge 15.6 (NP750XQA)";
	compatible = "samsung,galaxy-book4-edge-np750xqa", "qcom,x1p42100";
	chassis-type = "laptop";

	aliases {
		serial0 = &uart21;
		serial1 = &uart14;
	};

	backlight: backlight {
		compatible = "pwm-backlight";
		pwms = <&pmk8550_pwm 0 52083>;
		enable-gpios = <&pmc8380_3_gpios 4 GPIO_ACTIVE_HIGH>;
		power-supply = <&vreg_edp_bl>;

		pinctrl-0 = <&edp_bl_en>, <&edp_bl_pwm>;
		pinctrl-names = "default";
	};

	wcd938x: audio-codec {
		compatible = "qcom,wcd9385-codec";

		pinctrl-names = "default";
		pinctrl-0 = <&wcd_default>;

		qcom,micbias1-microvolt = <1800000>;
		qcom,micbias2-microvolt = <1800000>;
		qcom,micbias3-microvolt = <1800000>;
		qcom,micbias4-microvolt = <1800000>;
		qcom,mbhc-buttons-vthreshold-microvolt = <75000 150000 237000 500000 500000 500000 500000 500000>;
		qcom,mbhc-headset-vthreshold-microvolt = <1700000>;
		qcom,mbhc-headphone-vthreshold-microvolt = <50000>;
		qcom,rx-device = <&wcd_rx>;
		qcom,tx-device = <&wcd_tx>;

		reset-gpios = <&tlmm 191 GPIO_ACTIVE_LOW>;

		vdd-buck-supply = <&vreg_l15b_1p8>;
		vdd-rxtx-supply = <&vreg_l15b_1p8>;
		vdd-io-supply = <&vreg_l15b_1p8>;
		vdd-mic-bias-supply = <&vreg_bob1>;

		#sound-dai-cells = <1>;
	};

	gpio-keys {
		compatible = "gpio-keys";

		pinctrl-0 = <&hall_int_n_default>;
		pinctrl-names = "default";

		switch-lid {
			gpios = <&tlmm 92 GPIO_ACTIVE_LOW>;
			linux,input-type = <EV_SW>;
			linux,code = <SW_LID>;
			wakeup-source;
			wakeup-event-action = <EV_ACT_DEASSERTED>;
		};
	};

	hdmi-connector {
		compatible = "hdmi-connector";
		type = "a";
		pinctrl-0 = <&hdmi_hpd_default>;
		pinctrl-names = "default";

		port {
			hdmi_con: endpoint {
				remote-endpoint = <&usb_1_ss2_qmpphy_out>;
			};
		};
	};

	pmic-glink {
		compatible = "qcom,x1e80100-pmic-glink",
			     "qcom,sm8550-pmic-glink",
			     "qcom,pmic-glink";
		#address-cells = <1>;
		#size-cells = <0>;
		orientation-gpios = <&tlmm 121 GPIO_ACTIVE_HIGH>,
				    <&tlmm 123 GPIO_ACTIVE_HIGH>,
				    <&tlmm 125 GPIO_ACTIVE_HIGH>;

		/* Left-side rear port */
		connector@0 {
			compatible = "usb-c-connector";
			reg = <0>;
			power-role = "dual";
			data-role = "dual";

			ports {
				#address-cells = <1>;
				#size-cells = <0>;

				port@0 {
					reg = <0>;

					pmic_glink_ss0_hs_in: endpoint {
						remote-endpoint = <&usb_1_ss0_dwc3_hs>;
					};
				};

				port@1 {
					reg = <1>;

					pmic_glink_ss0_ss_in: endpoint {
						remote-endpoint = <&usb_1_ss0_qmpphy_out>;
					};
				};

				port@2 {
					reg = <2>;

					pmic_glink_ss0_sbu: endpoint {
						remote-endpoint = <&usb_1_ss0_sbu_mux>;
					};
				};
			};
		};

		/* Left-side front port */
		connector@1 {
			compatible = "usb-c-connector";
			reg = <1>;
			power-role = "dual";
			data-role = "dual";

			ports {
				#address-cells = <1>;
				#size-cells = <0>;

				port@0 {
					reg = <0>;

					pmic_glink_ss1_hs_in: endpoint {
						remote-endpoint = <&usb_1_ss1_dwc3_hs>;
					};
				};

				port@1 {
					reg = <1>;

					pmic_glink_ss1_ss_in: endpoint {
						remote-endpoint = <&usb_1_ss1_qmpphy_out>;
					};
				};

				port@2 {
					reg = <2>;

					pmic_glink_ss1_sbu: endpoint {
						remote-endpoint = <&usb_1_ss1_sbu_mux>;
					};
				};
			};
		};
	};

	reserved-memory {
		linux,cma {
			compatible = "shared-dma-pool";
			size = <0x0 0x8000000>;
			reusable;
			linux,cma-default;
		};
	};

	sound {
		compatible = "qcom,x1e80100-sndcard";
		model = "X1E80100-CRD";
		audio-routing = "SpkrLeft IN", "WSA WSA_SPK1 OUT",
				"SpkrRight IN", "WSA WSA_SPK2 OUT",
				"IN1_HPHL", "HPHL_OUT",
				"IN2_HPHR", "HPHR_OUT",
				"AMIC2", "MIC BIAS2",
				"VA DMIC0", "MIC BIAS3",
				"VA DMIC1", "MIC BIAS3",
				"VA DMIC2", "MIC BIAS1",
				"VA DMIC3", "MIC BIAS1",
				"VA DMIC0", "VA MIC BIAS3",
				"VA DMIC1", "VA MIC BIAS3",
				"VA DMIC2", "VA MIC BIAS1",
				"VA DMIC3", "VA MIC BIAS1",
				"TX SWR_INPUT1", "ADC2_OUTPUT";

		wcd-playback-dai-link {
			link-name = "WCD Playback";

			cpu {
				sound-dai = <&q6apmbedai RX_CODEC_DMA_RX_0>;
			};

			codec {
				sound-dai = <&wcd938x 0>, <&swr1 0>, <&lpass_rxmacro 0>;
			};

			platform {
				sound-dai = <&q6apm>;
			};
		};

		wcd-capture-dai-link {
			link-name = "WCD Capture";

			cpu {
				sound-dai = <&q6apmbedai TX_CODEC_DMA_TX_3>;
			};

			codec {
				sound-dai = <&wcd938x 1>, <&swr2 1>, <&lpass_txmacro 0>;
			};

			platform {
				sound-dai = <&q6apm>;
			};
		};

		wsa-dai-link {
			link-name = "WSA Playback";

			cpu {
				sound-dai = <&q6apmbedai WSA_CODEC_DMA_RX_0>;
			};

			codec {
				sound-dai = <&left_spkr>, <&right_spkr>,
					    <&swr0 0>, <&lpass_wsamacro 0>;
			};

			platform {
				sound-dai = <&q6apm>;
			};
		};

		va-dai-link {
			link-name = "VA Capture";

			cpu {
				sound-dai = <&q6apmbedai VA_CODEC_DMA_TX_0>;
			};

			codec {
				sound-dai = <&lpass_vamacro 0>;
			};

			platform {
				sound-dai = <&q6apm>;
			};
		};
	};

	vreg_edp_3p3: regulator-edp-3p3 {
		compatible = "regulator-fixed";

		regulator-name = "VREG_EDP_3P3";
		regulator-min-microvolt = <3300000>;
		regulator-max-microvolt = <3300000>;

		gpio = <&tlmm 70 GPIO_ACTIVE_HIGH>;
		enable-active-high;

		pinctrl-0 = <&edp_reg_en>;
		pinctrl-names = "default";

		/* The regulator core disabling this as unused blanks the panel. */
		regulator-always-on;
		regulator-boot-on;
	};

	vreg_edp_bl: regulator-edp-bl {
		compatible = "regulator-fixed";

		regulator-name = "VBL9";
		regulator-min-microvolt = <3600000>;
		regulator-max-microvolt = <3600000>;

		gpio = <&pmc8380_3_gpios 10 GPIO_ACTIVE_HIGH>;
		enable-active-high;

		pinctrl-names = "default";
		pinctrl-0 = <&edp_bl_reg_en>;

		regulator-boot-on;
	};


	vreg_misc_3p3: regulator-misc-3p3 {
		compatible = "regulator-fixed";

		regulator-name = "VREG_MISC_3P3";
		regulator-min-microvolt = <3300000>;
		regulator-max-microvolt = <3300000>;

		gpio = <&pm8550ve_8_gpios 6 GPIO_ACTIVE_HIGH>;
		enable-active-high;

		pinctrl-names = "default";
		pinctrl-0 = <&misc_3p3_reg_en>;

		regulator-boot-on;
		regulator-always-on;
	};

	vph_pwr: regulator-vph-pwr {
		compatible = "regulator-fixed";

		regulator-name = "vph_pwr";
		regulator-min-microvolt = <3700000>;
		regulator-max-microvolt = <3700000>;

		regulator-always-on;
		regulator-boot-on;
	};

	vreg_wcn_3p3: regulator-wcn-3p3 {
		compatible = "regulator-fixed";

		regulator-name = "VREG_WCN_3P3";
		regulator-min-microvolt = <3300000>;
		regulator-max-microvolt = <3300000>;

		gpio = <&tlmm 214 GPIO_ACTIVE_HIGH>;
		enable-active-high;

		pinctrl-0 = <&wcn_sw_en>;
		pinctrl-names = "default";

		regulator-boot-on;
		regulator-always-on;
	};

	usb-1-ss0-sbu-mux {
		compatible = "onnn,fsusb42", "gpio-sbu-mux";

		enable-gpios = <&tlmm 168 GPIO_ACTIVE_LOW>;
		select-gpios = <&tlmm 167 GPIO_ACTIVE_HIGH>;

		pinctrl-0 = <&usb_1_ss0_sbu_default>;
		pinctrl-names = "default";

		mode-switch;
		orientation-switch;

		port {
			usb_1_ss0_sbu_mux: endpoint {
				remote-endpoint = <&pmic_glink_ss0_sbu>;
			};
		};
	};

	usb-1-ss1-sbu-mux {
		compatible = "onnn,fsusb42", "gpio-sbu-mux";

		enable-gpios = <&tlmm 179 GPIO_ACTIVE_LOW>;
		select-gpios = <&tlmm 178 GPIO_ACTIVE_HIGH>;

		pinctrl-0 = <&usb_1_ss1_sbu_default>;
		pinctrl-names = "default";

		mode-switch;
		orientation-switch;

		port {
			usb_1_ss1_sbu_mux: endpoint {
				remote-endpoint = <&pmic_glink_ss1_sbu>;
			};
		};
	};

	wcn7850-pmu {
		compatible = "qcom,wcn7850-pmu";

		wlan-enable-gpios = <&tlmm 117 GPIO_ACTIVE_HIGH>;
		bt-enable-gpios = <&tlmm 116 GPIO_ACTIVE_HIGH>;

		pinctrl-0 = <&wcn_wlan_bt_en>;
		pinctrl-names = "default";

		regulators {
			vreg_pmu_rfa_cmn: ldo0 {
				regulator-name = "vreg_pmu_rfa_cmn";
			};

			vreg_pmu_aon_0p59: ldo1 {
				regulator-name = "vreg_pmu_aon_0p59";
			};

			vreg_pmu_wlcx_0p8: ldo2 {
				regulator-name = "vreg_pmu_wlcx_0p8";
			};

			vreg_pmu_wlmx_0p85: ldo3 {
				regulator-name = "vreg_pmu_wlmx_0p85";
			};

			vreg_pmu_btcmx_0p85: ldo4 {
				regulator-name = "vreg_pmu_btcmx_0p85";
			};

			vreg_pmu_rfa_0p8: ldo5 {
				regulator-name = "vreg_pmu_rfa_0p8";
			};

			vreg_pmu_rfa_1p2: ldo6 {
				regulator-name = "vreg_pmu_rfa_1p2";
			};

			vreg_pmu_rfa_1p8: ldo7 {
				regulator-name = "vreg_pmu_rfa_1p8";
			};

			vreg_pmu_pcie_0p9: ldo8 {
				regulator-name = "vreg_pmu_pcie_0p9";
			};

			vreg_pmu_pcie_1p8: ldo9 {
				regulator-name = "vreg_pmu_pcie_1p8";
			};
		};
	};
};

&apps_rsc {
	regulators-0 {
		compatible = "qcom,pm8550-rpmh-regulators";
		qcom,pmic-id = "b";

		vdd-bob1-supply = <&vph_pwr>;
		vdd-bob2-supply = <&vph_pwr>;
		vdd-l1-l4-l10-supply = <&vreg_s4c_1p8>;
		vdd-l2-l13-l14-supply = <&vreg_bob1>;
		vdd-l5-l16-supply = <&vreg_bob1>;
		vdd-l6-l7-supply = <&vreg_bob2>;
		vdd-l8-l9-supply = <&vreg_bob1>;
		vdd-l12-supply = <&vreg_s5j_1p2>;
		vdd-l15-supply = <&vreg_s4c_1p8>;
		vdd-l17-supply = <&vreg_bob2>;

		vreg_bob1: bob1 {
			regulator-name = "vreg_bob1";
			regulator-min-microvolt = <3008000>;
			regulator-max-microvolt = <3960000>;
			regulator-initial-mode = <RPMH_REGULATOR_MODE_HPM>;
		};

		vreg_bob2: bob2 {
			regulator-name = "vreg_bob2";
			regulator-min-microvolt = <2504000>;
			regulator-max-microvolt = <3008000>;
			regulator-initial-mode = <RPMH_REGULATOR_MODE_HPM>;
		};

		vreg_l1b_1p8: ldo1 {
			regulator-name = "vreg_l1b_1p8";
			regulator-min-microvolt = <1800000>;
			regulator-max-microvolt = <1800000>;
			regulator-initial-mode = <RPMH_REGULATOR_MODE_HPM>;
		};

		vreg_l2b_3p0: ldo2 {
			regulator-name = "vreg_l2b_3p0";
			regulator-min-microvolt = <3072000>;
			regulator-max-microvolt = <3100000>;
			regulator-initial-mode = <RPMH_REGULATOR_MODE_HPM>;
		};

		vreg_l4b_1p8: ldo4 {
			regulator-name = "vreg_l4b_1p8";
			regulator-min-microvolt = <1800000>;
			regulator-max-microvolt = <1800000>;
			regulator-initial-mode = <RPMH_REGULATOR_MODE_HPM>;
		};

		vreg_l5b_3p0: ldo5 {
			regulator-name = "vreg_l5b_3p0";
			regulator-min-microvolt = <3000000>;
			regulator-max-microvolt = <3000000>;
			regulator-initial-mode = <RPMH_REGULATOR_MODE_HPM>;
		};

		vreg_l6b_1p8: ldo6 {
			regulator-name = "vreg_l6b_1p8";
			regulator-min-microvolt = <1800000>;
			regulator-max-microvolt = <2960000>;
			regulator-initial-mode = <RPMH_REGULATOR_MODE_HPM>;
		};

		vreg_l7b_2p8: ldo7 {
			regulator-name = "vreg_l7b_2p8";
			/* camera AVDD/DOVDD: cycling them makes the sensor drop off I2C */
			regulator-always-on;
			regulator-min-microvolt = <2800000>;
			regulator-max-microvolt = <2800000>;
			regulator-initial-mode = <RPMH_REGULATOR_MODE_HPM>;
		};

		vreg_l8b_3p0: ldo8 {
			regulator-name = "vreg_l8b_3p0";
			regulator-min-microvolt = <3072000>;
			regulator-max-microvolt = <3072000>;
			regulator-initial-mode = <RPMH_REGULATOR_MODE_HPM>;
		};

		vreg_l9b_2p9: ldo9 {
			regulator-name = "vreg_l9b_2p9";
			regulator-min-microvolt = <2960000>;
			regulator-max-microvolt = <2960000>;
			regulator-initial-mode = <RPMH_REGULATOR_MODE_HPM>;
		};

		vreg_l10b_1p8: ldo10 {
			regulator-name = "vreg_l10b_1p8";
			/* camera AVDD/DOVDD: cycling them makes the sensor drop off I2C */
			regulator-always-on;
			regulator-min-microvolt = <1800000>;
			regulator-max-microvolt = <1800000>;
			regulator-initial-mode = <RPMH_REGULATOR_MODE_HPM>;
		};

		vreg_l12b_1p2: ldo12 {
			regulator-name = "vreg_l12b_1p2";
			regulator-min-microvolt = <1200000>;
			regulator-max-microvolt = <1200000>;
			regulator-initial-mode = <RPMH_REGULATOR_MODE_HPM>;
			regulator-always-on;
		};

		vreg_l13b_3p0: ldo13 {
			regulator-name = "vreg_l13b_3p0";
			regulator-min-microvolt = <3072000>;
			regulator-max-microvolt = <3100000>;
			regulator-initial-mode = <RPMH_REGULATOR_MODE_HPM>;
		};

		vreg_l14b_3p0: ldo14 {
			regulator-name = "vreg_l14b_3p0";
			regulator-min-microvolt = <3072000>;
			regulator-max-microvolt = <3072000>;
			regulator-initial-mode = <RPMH_REGULATOR_MODE_HPM>;
		};

		vreg_l15b_1p8: ldo15 {
			regulator-name = "vreg_l15b_1p8";
			regulator-min-microvolt = <1800000>;
			regulator-max-microvolt = <1800000>;
			regulator-initial-mode = <RPMH_REGULATOR_MODE_HPM>;
			regulator-always-on;
		};

		vreg_l16b_2p9: ldo16 {
			regulator-name = "vreg_l16b_2p9";
			regulator-min-microvolt = <2912000>;
			regulator-max-microvolt = <2912000>;
			regulator-initial-mode = <RPMH_REGULATOR_MODE_HPM>;
		};

		vreg_l17b_2p5: ldo17 {
			regulator-name = "vreg_l17b_2p5";
			regulator-min-microvolt = <2504000>;
			regulator-max-microvolt = <2504000>;
			regulator-initial-mode = <RPMH_REGULATOR_MODE_HPM>;
		};
	};

	regulators-1 {
		compatible = "qcom,pm8550ve-rpmh-regulators";
		qcom,pmic-id = "c";

		vdd-l1-supply = <&vreg_s5j_1p2>;
		vdd-l2-supply = <&vreg_s1f_0p7>;
		vdd-l3-supply = <&vreg_s1f_0p7>;
		vdd-s4-supply = <&vph_pwr>;

		vreg_s4c_1p8: smps4 {
			regulator-name = "vreg_s4c_1p8";
			regulator-min-microvolt = <1856000>;
			regulator-max-microvolt = <2000000>;
			regulator-initial-mode = <RPMH_REGULATOR_MODE_HPM>;
		};

		vreg_l1c_1p2: ldo1 {
			regulator-name = "vreg_l1c_1p2";
			regulator-min-microvolt = <1200000>;
			regulator-max-microvolt = <1200000>;
			regulator-initial-mode = <RPMH_REGULATOR_MODE_HPM>;
		};

		vreg_l2c_0p8: ldo2 {
			regulator-name = "vreg_l2c_0p8";
			regulator-min-microvolt = <880000>;
			regulator-max-microvolt = <920000>;
			regulator-initial-mode = <RPMH_REGULATOR_MODE_HPM>;
		};

		vreg_l3c_0p8: ldo3 {
			regulator-name = "vreg_l3c_0p8";
			regulator-min-microvolt = <880000>;
			regulator-max-microvolt = <920000>;
			regulator-initial-mode = <RPMH_REGULATOR_MODE_HPM>;
		};
	};

	regulators-2 {
		compatible = "qcom,pmc8380-rpmh-regulators";
		qcom,pmic-id = "d";

		vdd-l1-supply = <&vreg_s1f_0p7>;
		vdd-l2-supply = <&vreg_s1f_0p7>;
		vdd-l3-supply = <&vreg_s4c_1p8>;
		vdd-s1-supply = <&vph_pwr>;

		vreg_l1d_0p8: ldo1 {
			regulator-name = "vreg_l1d_0p8";
			regulator-min-microvolt = <880000>;
			regulator-max-microvolt = <920000>;
			regulator-initial-mode = <RPMH_REGULATOR_MODE_HPM>;
		};

		vreg_l2d_0p9: ldo2 {
			regulator-name = "vreg_l2d_0p9";
			regulator-min-microvolt = <912000>;
			regulator-max-microvolt = <920000>;
			regulator-initial-mode = <RPMH_REGULATOR_MODE_HPM>;
		};

		vreg_l3d_1p8: ldo3 {
			regulator-name = "vreg_l3d_1p8";
			regulator-min-microvolt = <1800000>;
			regulator-max-microvolt = <1800000>;
			regulator-initial-mode = <RPMH_REGULATOR_MODE_HPM>;
		};
	};

	regulators-3 {
		compatible = "qcom,pmc8380-rpmh-regulators";
		qcom,pmic-id = "e";

		vdd-l2-supply = <&vreg_s1f_0p7>;
		vdd-l3-supply = <&vreg_s5j_1p2>;

		vreg_l2e_0p8: ldo2 {
			regulator-name = "vreg_l2e_0p8";
			regulator-min-microvolt = <880000>;
			regulator-max-microvolt = <920000>;
			regulator-initial-mode = <RPMH_REGULATOR_MODE_HPM>;
		};

		vreg_l3e_1p2: ldo3 {
			regulator-name = "vreg_l3e_1p2";
			regulator-min-microvolt = <1200000>;
			regulator-max-microvolt = <1200000>;
			regulator-initial-mode = <RPMH_REGULATOR_MODE_HPM>;
		};
	};

	regulators-4 {
		compatible = "qcom,pmc8380-rpmh-regulators";
		qcom,pmic-id = "f";

		vdd-l1-supply = <&vreg_s5j_1p2>;
		vdd-l2-supply = <&vreg_s5j_1p2>;
		vdd-l3-supply = <&vreg_s5j_1p2>;
		vdd-s1-supply = <&vph_pwr>;

		vreg_s1f_0p7: smps1 {
			regulator-name = "vreg_s1f_0p7";
			regulator-min-microvolt = <700000>;
			regulator-max-microvolt = <1100000>;
			regulator-initial-mode = <RPMH_REGULATOR_MODE_HPM>;
		};

		vreg_l1f_1p0: ldo1 {
			regulator-name = "vreg_l1f_1p0";
			regulator-min-microvolt = <1024000>;
			regulator-max-microvolt = <1024000>;
			regulator-initial-mode = <RPMH_REGULATOR_MODE_HPM>;
		};

		vreg_l2f_1p0: ldo2 {
			regulator-name = "vreg_l2f_1p0";
			regulator-min-microvolt = <1024000>;
			regulator-max-microvolt = <1024000>;
			regulator-initial-mode = <RPMH_REGULATOR_MODE_HPM>;
		};

		vreg_l3f_1p0: ldo3 {
			regulator-name = "vreg_l3f_1p0";
			regulator-min-microvolt = <1024000>;
			regulator-max-microvolt = <1024000>;
			regulator-initial-mode = <RPMH_REGULATOR_MODE_HPM>;
		};
	};

	regulators-6 {
		compatible = "qcom,pm8550ve-rpmh-regulators";
		qcom,pmic-id = "i";

		vdd-l1-supply = <&vreg_s4c_1p8>;
		vdd-l2-supply = <&vreg_s5j_1p2>;
		vdd-l3-supply = <&vreg_s1f_0p7>;
		vdd-s1-supply = <&vph_pwr>;
		vdd-s2-supply = <&vph_pwr>;

		vreg_s1i_0p9: smps1 {
			regulator-name = "vreg_s1i_0p9";
			regulator-min-microvolt = <900000>;
			regulator-max-microvolt = <920000>;
			regulator-initial-mode = <RPMH_REGULATOR_MODE_HPM>;
		};

		vreg_s2i_1p0: smps2 {
			regulator-name = "vreg_s2i_1p0";
			regulator-min-microvolt = <1000000>;
			regulator-max-microvolt = <1100000>;
			regulator-initial-mode = <RPMH_REGULATOR_MODE_HPM>;
		};

		vreg_l1i_1p8: ldo1 {
			regulator-name = "vreg_l1i_1p8";
			regulator-min-microvolt = <1800000>;
			regulator-max-microvolt = <1800000>;
			regulator-initial-mode = <RPMH_REGULATOR_MODE_HPM>;
		};

		vreg_l2i_1p2: ldo2 {
			regulator-name = "vreg_l2i_1p2";
			regulator-min-microvolt = <1200000>;
			regulator-max-microvolt = <1200000>;
			regulator-initial-mode = <RPMH_REGULATOR_MODE_HPM>;
		};

		vreg_l3i_0p8: ldo3 {
			regulator-name = "vreg_l3i_0p8";
			regulator-min-microvolt = <880000>;
			regulator-max-microvolt = <920000>;
			regulator-initial-mode = <RPMH_REGULATOR_MODE_HPM>;
		};
	};

	regulators-7 {
		compatible = "qcom,pm8550ve-rpmh-regulators";
		qcom,pmic-id = "j";

		vdd-l1-supply = <&vreg_s1f_0p7>;
		vdd-l2-supply = <&vreg_s5j_1p2>;
		vdd-l3-supply = <&vreg_s1f_0p7>;
		vdd-s5-supply = <&vph_pwr>;

		vreg_s5j_1p2: smps5 {
			regulator-name = "vreg_s5j_1p2";
			regulator-min-microvolt = <1256000>;
			regulator-max-microvolt = <1304000>;
			regulator-initial-mode = <RPMH_REGULATOR_MODE_HPM>;
		};

		vreg_l1j_0p8: ldo1 {
			regulator-name = "vreg_l1j_0p8";
			regulator-min-microvolt = <880000>;
			regulator-max-microvolt = <920000>;
			regulator-initial-mode = <RPMH_REGULATOR_MODE_HPM>;
		};

		vreg_l2j_1p2: ldo2 {
			regulator-name = "vreg_l2j_1p2";
			regulator-min-microvolt = <1256000>;
			regulator-max-microvolt = <1256000>;
			regulator-initial-mode = <RPMH_REGULATOR_MODE_HPM>;
		};

		vreg_l3j_0p8: ldo3 {
			regulator-name = "vreg_l3j_0p8";
			regulator-min-microvolt = <880000>;
			regulator-max-microvolt = <920000>;
			regulator-initial-mode = <RPMH_REGULATOR_MODE_HPM>;
		};
	};
};

&gpu {
       status = "okay";

       zap-shader {
               firmware-name = "qcom/x1p42100/SAMSUNG/NP750XQA/qcdxkmsucpurwa.mbn";
       };
};

&i2c0 {
	clock-frequency = <400000>;

	status = "okay";

	keyboard@5 {
		compatible = "hid-over-i2c";
		reg = <0x5>;

		hid-descr-addr = <0x20>;
		interrupts-extended = <&tlmm 67 IRQ_TYPE_LEVEL_LOW>;

		pinctrl-0 = <&kybd_default>;
		pinctrl-names = "default";

		wakeup-source;
	};
};

&i2c18 {
	clock-frequency = <400000>;

	status = "okay";

	eusb5_repeater: redriver@43 {
		compatible = "nxp,ptn3222";
		reg = <0x43>;
		#phy-cells = <0>;

		vdd3v3-supply = <&vreg_l13b_3p0>;
		vdd1v8-supply = <&vreg_l4b_1p8>;

		reset-gpios = <&tlmm 6 GPIO_ACTIVE_LOW>;

		pinctrl-0 = <&eusb5_reset_n>;
		pinctrl-names = "default";
	};

	eusb6_repeater: redriver@4f {
		compatible = "nxp,ptn3222";
		reg = <0x4f>;
		#phy-cells = <0>;

		vdd3v3-supply = <&vreg_l13b_3p0>;
		vdd1v8-supply = <&vreg_l4b_1p8>;

		reset-gpios = <&tlmm 7 GPIO_ACTIVE_LOW>;

		pinctrl-0 = <&eusb6_reset_n>;
		pinctrl-names = "default";
	};
};



&i2c13 {
	clock-frequency = <400000>;

	status = "okay";

	touchpad@15 {
		compatible = "hid-over-i2c";
		reg = <0x15>;

		hid-descr-addr = <0x1>;
		interrupts-extended = <&tlmm 3 IRQ_TYPE_LEVEL_LOW>;

		pinctrl-0 = <&tpad_default>;
		pinctrl-names = "default";
	};
};

&lpass_tlmm {
	spkr_01_sd_n_active: spkr-01-sd-n-active-state {
		pins = "gpio12";
		function = "gpio";
		drive-strength = <16>;
		bias-disable;
		output-low;
	};

	spkr_23_sd_n_active: spkr-23-sd-n-active-state {
		pins = "gpio13";
		function = "gpio";
		drive-strength = <16>;
		bias-disable;
		output-low;
	};
};

&lpass_vamacro {
	pinctrl-0 = <&dmic01_default>, <&dmic23_default>;
	pinctrl-names = "default";

	vdd-micb-supply = <&vreg_l1b_1p8>;
	/* 4.8 MHz leaves a ~17 kHz idle tone in the capture; 2.4 MHz does not */
	qcom,dmic-sample-rate = <2400000>;
};

&mdss {
	status = "okay";
};

&mdss_dp0 {
	status = "okay";
};

&mdss_dp0_out {
	data-lanes = <0 1>;
	link-frequencies = /bits/ 64 <1620000000 2700000000 5400000000 8100000000>;
};

&mdss_dp1 {
	status = "okay";
};

&mdss_dp1_out {
	data-lanes = <0 1>;
	link-frequencies = /bits/ 64 <1620000000 2700000000 5400000000 8100000000>;
};

&mdss_dp2 {
	status = "okay";
};

&mdss_dp2_out {
	data-lanes = <0 1 2 3>;
};

&mdss_dp3 {
	/delete-property/ #sound-dai-cells;

	pinctrl-0 = <&edp0_hpd_default>;
	pinctrl-names = "default";

	status = "okay";

	aux-bus {
		panel {
			compatible = "edp-panel";
			power-supply = <&vreg_edp_3p3>;
			backlight = <&backlight>;

			port {
				edp_panel_in: endpoint {
					remote-endpoint = <&mdss_dp3_out>;
				};
			};
		};
	};

	ports {
		port@1 {
			reg = <1>;
			mdss_dp3_out: endpoint {
				data-lanes = <0 1 2 3>;
				link-frequencies = /bits/ 64 <1620000000 2700000000 5400000000>;

				remote-endpoint = <&edp_panel_in>;
			};
		};
	};
};


&mdss_dp3_phy {
	vdda-phy-supply = <&vreg_l3j_0p8>;
	vdda-pll-supply = <&vreg_l2j_1p2>;

	status = "okay";
};

&pcie4 {
	perst-gpios = <&tlmm 146 GPIO_ACTIVE_LOW>;
	wake-gpios = <&tlmm 148 GPIO_ACTIVE_LOW>;

	pinctrl-0 = <&pcie4_default>;
	pinctrl-names = "default";

	status = "okay";
};

&pcie4_phy {
	vdda-phy-supply = <&vreg_l3i_0p8>;
	vdda-pll-supply = <&vreg_l3e_1p2>;

	status = "okay";
};

&pcie4_port0 {
	wifi@0 {
		compatible = "pci17cb,1107";
		reg = <0x10000 0x0 0x0 0x0 0x0>;

		vddaon-supply = <&vreg_pmu_aon_0p59>;
		vddwlcx-supply = <&vreg_pmu_wlcx_0p8>;
		vddwlmx-supply = <&vreg_pmu_wlmx_0p85>;
		vddrfacmn-supply = <&vreg_pmu_rfa_cmn>;
		vddrfa0p8-supply = <&vreg_pmu_rfa_0p8>;
		vddrfa1p2-supply = <&vreg_pmu_rfa_1p2>;
		vddrfa1p8-supply = <&vreg_pmu_rfa_1p8>;
		vddpcie0p9-supply = <&vreg_pmu_pcie_0p9>;
		vddpcie1p8-supply = <&vreg_pmu_pcie_1p8>;
	};
};

&pm8550ve_8_gpios {
	misc_3p3_reg_en: misc-3p3-reg-en-state {
		pins = "gpio6";
		function = "normal";
		bias-disable;
		input-disable;
		output-enable;
		drive-push-pull;
		power-source = <1>; /* 1.8 V */
		qcom,drive-strength = <PMIC_GPIO_STRENGTH_LOW>;
	};
};

&pmk8550_gpios {
	edp_bl_pwm: edp-bl-pwm-state {
		pins = "gpio5";
		function = "func3";
	};
};

&pmk8550_pwm {
	status = "okay";
};

&pmc8380_3_gpios {
	edp_bl_reg_en: edp-bl-reg-en-state {
		pins = "gpio10";
		function = "normal";
	};

	edp_bl_en: edp-bl-en-state {
		pins = "gpio4";
		function = "normal";
		power-source = <1>; /* 1.8V */
		input-disable;
		output-enable;
	};
};

&qupv3_0 {
	status = "okay";
};

&qupv3_1 {
	status = "okay";
};

&qupv3_2 {
	status = "okay";
};

&remoteproc_adsp {
	firmware-name = "qcom/x1p42100/SAMSUNG/NP750XQA/qcadsp8380.mbn",
			"qcom/x1p42100/SAMSUNG/NP750XQA/adsp_dtbs.elf";

	status = "okay";
};

&remoteproc_cdsp {
	firmware-name = "qcom/x1p42100/SAMSUNG/NP750XQA/qccdsp8380.mbn",
			"qcom/x1p42100/SAMSUNG/NP750XQA/cdsp_dtbs.elf";

	status = "okay";
};

&swr0 {
	status = "okay";

	pinctrl-0 = <&wsa_swr_active>, <&spkr_01_sd_n_active>;
	pinctrl-names = "default";

	/* WSA883x, Left Speaker */
	left_spkr: speaker@0,1 {
		compatible = "sdw10217020200";
		reg = <0 1>;
		powerdown-gpios = <&lpass_tlmm 12 GPIO_ACTIVE_LOW>;
		#sound-dai-cells = <0>;
		#thermal-sensor-cells = <0>;
		sound-name-prefix = "SpkrLeft";
		vdd-supply = <&vreg_l15b_1p8>;
	};

	/* WSA883x, Right Speaker */
	right_spkr: speaker@0,2 {
		compatible = "sdw10217020200";
		reg = <0 2>;
		powerdown-gpios = <&lpass_tlmm 12 GPIO_ACTIVE_LOW>;
		#sound-dai-cells = <0>;
		#thermal-sensor-cells = <0>;
		sound-name-prefix = "SpkrRight";
		vdd-supply = <&vreg_l15b_1p8>;
	};
};

&swr1 {
	status = "okay";

	/* WCD9385 RX */
	wcd_rx: codec@0,4 {
		compatible = "sdw20217010d00";
		reg = <0 4>;
		qcom,rx-port-mapping = <1 2 3 4 5>;
	};
};

&swr2 {
	status = "okay";

	/* WCD9385 TX */
	wcd_tx: codec@0,3 {
		compatible = "sdw20217010d00";
		reg = <0 3>;
		qcom,tx-port-mapping = <2 2 3 4>;
	};
};

/* WSA2 bus: no speakers wired on this board */
&swr3 {
	status = "disabled";

	pinctrl-0 = <&wsa2_swr_active>, <&spkr_23_sd_n_active>;
	pinctrl-names = "default";
};

&tlmm {
	gpio-reserved-ranges = <34 2>, /* Unused */
			       <44 4>; /* SPI (TPM) */

	edp_reg_en: edp-reg-en-state {
		pins = "gpio70";
		function = "gpio";
		drive-strength = <16>;
		bias-disable;
	};


	hall_int_n_default: hall-int-n-state {
		pins = "gpio92";
		function = "gpio";
		bias-disable;
	};

	kybd_default: kybd-default-state {
		pins = "gpio67";
		function = "gpio";
		bias-disable;
	};

	hdmi_hpd_default: hdmi-hpd-default-state {
		pins = "gpio126";
		function = "usb2_dp";
		bias-disable;
	};

	eusb5_reset_n: eusb5-reset-n-state {
		pins = "gpio6";
		function = "gpio";
		drive-strength = <2>;
		bias-disable;
		output-low;
	};

	eusb6_reset_n: eusb6-reset-n-state {
		pins = "gpio7";
		function = "gpio";
		drive-strength = <2>;
		bias-disable;
		output-low;
	};

	pcie4_default: pcie4-default-state {
		clkreq-n-pins {
			pins = "gpio147";
			function = "pcie4_clk";
			drive-strength = <2>;
			bias-pull-up;
		};

		perst-n-pins {
			pins = "gpio146";
			function = "gpio";
			drive-strength = <2>;
			bias-disable;
		};

		wake-n-pins {
			pins = "gpio148";
			function = "gpio";
			drive-strength = <2>;
			bias-pull-up;
		};
	};

	tpad_default: tpad-default-state {
		pins = "gpio3";
		function = "gpio";
		bias-disable;
	};

	usb_1_ss0_sbu_default: usb-1-ss0-sbu-state {
		mode-pins {
			pins = "gpio166";
			function = "gpio";
			bias-disable;
			drive-strength = <2>;
			output-high;
		};

		oe-n-pins {
			pins = "gpio168";
			function = "gpio";
			bias-disable;
			drive-strength = <2>;
		};

		sel-pins {
			pins = "gpio167";
			function = "gpio";
			bias-disable;
			drive-strength = <2>;
		};

	};

	usb_1_ss1_sbu_default: usb-1-ss1-sbu-state {
		mode-pins {
			pins = "gpio177";
			function = "gpio";
			bias-disable;
			drive-strength = <2>;
			output-high;
		};

		oe-n-pins {
			pins = "gpio179";
			function = "gpio";
			bias-disable;
			drive-strength = <2>;
		};

		sel-pins {
			pins = "gpio178";
			function = "gpio";
			bias-disable;
			drive-strength = <2>;
		};
	};

	usb_1_ss2_sbu_default: usb-1-ss2-sbu-state {
		mode-pins {
			pins = "gpio169";
			function = "gpio";
			bias-disable;
			drive-strength = <2>;
			output-high;
		};

		oe-n-pins {
			pins = "gpio171";
			function = "gpio";
			bias-disable;
			drive-strength = <2>;
		};

		sel-pins {
			pins = "gpio170";
			function = "gpio";
			bias-disable;
			drive-strength = <2>;
		};
	};

	wcn_sw_en: wcn-sw-en-state {
		pins = "gpio214";
		function = "gpio";
		drive-strength = <2>;
		bias-disable;
	};

	wcn_wlan_bt_en: wcn-wlan-bt-en-state {
		pins = "gpio116", "gpio117";
		function = "gpio";
		drive-strength = <2>;
		bias-disable;
	};

	wcd_default: wcd-reset-n-active-state {
		pins = "gpio191";
		function = "gpio";
		drive-strength = <16>;
		bias-disable;
		output-low;
	};
};

&ufs_mem_hc {
	status = "okay";

	reset-gpios = <&tlmm 238 GPIO_ACTIVE_LOW>;
	vcc-supply = <&vreg_l17b_2p5>;
	vcc-max-microamp = <600000>;

	vccq-supply = <&vreg_l2i_1p2>;
	vccq-max-microamp = <600000>;
};

&ufs_mem_phy {
	status = "okay";

	vdda-phy-supply = <&vreg_l3i_0p8>;
	vdda-pll-supply = <&vreg_l3e_1p2>;
};

&uart14 {
	status = "okay";

	bluetooth {
		compatible = "qcom,wcn7850-bt";
		/*
		 * No local-bd-address: nothing on this platform injects one, and
		 * without it the controller comes up with the QCA default address.
		 * Put your own here (bytes reversed, e.g. AA:BB:CC:DD:EE:FF becomes
		 * [ff ee dd cc bb aa]) or set it at runtime with btmgmt public-addr.
		 */
		max-speed = <3200000>;

		vddaon-supply = <&vreg_pmu_aon_0p59>;
		vddwlcx-supply = <&vreg_pmu_wlcx_0p8>;
		vddwlmx-supply = <&vreg_pmu_wlmx_0p85>;
		vddrfacmn-supply = <&vreg_pmu_rfa_cmn>;
		vddrfa0p8-supply = <&vreg_pmu_rfa_0p8>;
		vddrfa1p2-supply = <&vreg_pmu_rfa_1p2>;
		vddrfa1p8-supply = <&vreg_pmu_rfa_1p8>;
	};
};

&uart21 {
	compatible = "qcom,geni-debug-uart";
	status = "okay";
};

/* usb1 covers left side typec ports */

/* back(towards the display) typec port */
&usb_1_ss0 {
	status = "okay";
};

&usb_1_ss0_hsphy {
	vdd-supply = <&vreg_l3j_0p8>;
	vdda12-supply = <&vreg_l2j_1p2>;

	status = "okay";
};

&usb_1_ss0_qmpphy {
	vdda-phy-supply = <&vreg_l2j_1p2>;
	vdda-pll-supply = <&vreg_l1j_0p8>;

	status = "okay";
};

&usb_1_ss0 {
	dr_mode = "host";
};

&usb_1_ss0_dwc3_hs {
	remote-endpoint = <&pmic_glink_ss0_hs_in>;
};

&usb_1_ss0_qmpphy_out {
	remote-endpoint = <&pmic_glink_ss0_ss_in>;
};

/* front typec port */
&usb_1_ss1 {
	status = "okay";
};

&usb_1_ss1_hsphy {
	vdd-supply = <&vreg_l3j_0p8>;
	vdda12-supply = <&vreg_l2j_1p2>;

	status = "okay";
};

&usb_1_ss1_qmpphy {
	vdda-phy-supply = <&vreg_l2j_1p2>;
	vdda-pll-supply = <&vreg_l2d_0p9>;

	status = "okay";
};

&usb_1_ss1 {
	dr_mode = "host";
};

&usb_1_ss1_dwc3_hs {
	remote-endpoint = <&pmic_glink_ss1_hs_in>;
};

&usb_1_ss1_qmpphy_out {
	remote-endpoint = <&pmic_glink_ss1_ss_in>;
};

/* DP-HDMI bridge connected here? */
&usb_1_ss2_qmpphy {
	vdda-phy-supply = <&vreg_l2j_1p2>;
	vdda-pll-supply = <&vreg_l2d_0p9>;

	qcom,combo-initial-mode = "dp";

	/delete-property/ mode-switch;
	/delete-property/ orientation-switch;

	status = "okay";
};

&usb_1_ss2_qmpphy_out {
	remote-endpoint = <&hdmi_con>;
};


/* MP0 goes to the USB-A port(USB3) and FPC */
&usb_mp {
	status = "okay";
};

&usb_mp_hsphy0 {
	vdd-supply = <&vreg_l2e_0p8>;
	vdda12-supply = <&vreg_l3e_1p2>;

	phys = <&eusb5_repeater>;

	status = "okay";
};

&usb_mp_hsphy1 {
	vdd-supply = <&vreg_l2e_0p8>;
	vdda12-supply = <&vreg_l3e_1p2>;

	phys = <&eusb6_repeater>;

	status = "okay";
};

&usb_mp_qmpphy0 {
	vdda-phy-supply = <&vreg_l3e_1p2>;
	vdda-pll-supply = <&vreg_l3c_0p8>;

	status = "okay";
};

&usb_mp_qmpphy1 {
	vdda-phy-supply = <&vreg_l3e_1p2>;
	vdda-pll-supply = <&vreg_l3c_0p8>;

	status = "okay";
};

&pmc8380_6 {
	status = "disabled";
};

&i2c5 {
	clock-frequency = <400000>;
	status = "okay";

	/*
	 * ENE KB9058 embedded controller: command endpoint 0x62 here, EC-RAM
	 * mailbox at 0x64 on i2c0. Driver: samsung-galaxybook-ec.
	 */
	embedded-controller@62 {
		compatible = "samsung,galaxy-book4-edge-ec";
		reg = <0x62>;

		/* DSDT ECTC: GpioInt(Edge, ActiveLow, SharedAndWake, PullUp) pin 0x42 */
		interrupts-extended = <&tlmm 66 IRQ_TYPE_EDGE_FALLING>;

		pinctrl-0 = <&ec_int_n_default>;
		pinctrl-names = "default";

		samsung,ec-bus = <&i2c0>;
		samsung,ec-bus-reg = <0x64>;

		#cooling-cells = <2>;
	};
};

&tlmm {
	ec_int_n_default: ec-int-n-state {
		pins = "gpio66";
		function = "gpio";
		bias-pull-up;
	};
};

/* CPU passive throttling (95 C) so sustained load slows down instead of powering off. */
&{/thermal-zones/cpu0-0-top-thermal} {
	trips {
		cpu0_0_top_alert: trip-point0 {
			temperature = <95000>;
			hysteresis = <2000>;
			type = "passive";
		};
	};

	cooling-maps {
		map0 {
			trip = <&cpu0_0_top_alert>;
			cooling-device = <&cpu0 THERMAL_NO_LIMIT THERMAL_NO_LIMIT>, <&cpu1 THERMAL_NO_LIMIT THERMAL_NO_LIMIT>, <&cpu2 THERMAL_NO_LIMIT THERMAL_NO_LIMIT>, <&cpu3 THERMAL_NO_LIMIT THERMAL_NO_LIMIT>;
		};
	};
};

&{/thermal-zones/cpu0-0-btm-thermal} {
	trips {
		cpu0_0_btm_alert: trip-point0 {
			temperature = <95000>;
			hysteresis = <2000>;
			type = "passive";
		};
	};

	cooling-maps {
		map0 {
			trip = <&cpu0_0_btm_alert>;
			cooling-device = <&cpu0 THERMAL_NO_LIMIT THERMAL_NO_LIMIT>, <&cpu1 THERMAL_NO_LIMIT THERMAL_NO_LIMIT>, <&cpu2 THERMAL_NO_LIMIT THERMAL_NO_LIMIT>, <&cpu3 THERMAL_NO_LIMIT THERMAL_NO_LIMIT>;
		};
	};
};

&{/thermal-zones/cpu0-1-top-thermal} {
	trips {
		cpu0_1_top_alert: trip-point0 {
			temperature = <95000>;
			hysteresis = <2000>;
			type = "passive";
		};
	};

	cooling-maps {
		map0 {
			trip = <&cpu0_1_top_alert>;
			cooling-device = <&cpu0 THERMAL_NO_LIMIT THERMAL_NO_LIMIT>, <&cpu1 THERMAL_NO_LIMIT THERMAL_NO_LIMIT>, <&cpu2 THERMAL_NO_LIMIT THERMAL_NO_LIMIT>, <&cpu3 THERMAL_NO_LIMIT THERMAL_NO_LIMIT>;
		};
	};
};

&{/thermal-zones/cpu0-1-btm-thermal} {
	trips {
		cpu0_1_btm_alert: trip-point0 {
			temperature = <95000>;
			hysteresis = <2000>;
			type = "passive";
		};
	};

	cooling-maps {
		map0 {
			trip = <&cpu0_1_btm_alert>;
			cooling-device = <&cpu0 THERMAL_NO_LIMIT THERMAL_NO_LIMIT>, <&cpu1 THERMAL_NO_LIMIT THERMAL_NO_LIMIT>, <&cpu2 THERMAL_NO_LIMIT THERMAL_NO_LIMIT>, <&cpu3 THERMAL_NO_LIMIT THERMAL_NO_LIMIT>;
		};
	};
};

&{/thermal-zones/cpu0-2-top-thermal} {
	trips {
		cpu0_2_top_alert: trip-point0 {
			temperature = <95000>;
			hysteresis = <2000>;
			type = "passive";
		};
	};

	cooling-maps {
		map0 {
			trip = <&cpu0_2_top_alert>;
			cooling-device = <&cpu0 THERMAL_NO_LIMIT THERMAL_NO_LIMIT>, <&cpu1 THERMAL_NO_LIMIT THERMAL_NO_LIMIT>, <&cpu2 THERMAL_NO_LIMIT THERMAL_NO_LIMIT>, <&cpu3 THERMAL_NO_LIMIT THERMAL_NO_LIMIT>;
		};
	};
};

&{/thermal-zones/cpu0-2-btm-thermal} {
	trips {
		cpu0_2_btm_alert: trip-point0 {
			temperature = <95000>;
			hysteresis = <2000>;
			type = "passive";
		};
	};

	cooling-maps {
		map0 {
			trip = <&cpu0_2_btm_alert>;
			cooling-device = <&cpu0 THERMAL_NO_LIMIT THERMAL_NO_LIMIT>, <&cpu1 THERMAL_NO_LIMIT THERMAL_NO_LIMIT>, <&cpu2 THERMAL_NO_LIMIT THERMAL_NO_LIMIT>, <&cpu3 THERMAL_NO_LIMIT THERMAL_NO_LIMIT>;
		};
	};
};

&{/thermal-zones/cpu0-3-top-thermal} {
	trips {
		cpu0_3_top_alert: trip-point0 {
			temperature = <95000>;
			hysteresis = <2000>;
			type = "passive";
		};
	};

	cooling-maps {
		map0 {
			trip = <&cpu0_3_top_alert>;
			cooling-device = <&cpu0 THERMAL_NO_LIMIT THERMAL_NO_LIMIT>, <&cpu1 THERMAL_NO_LIMIT THERMAL_NO_LIMIT>, <&cpu2 THERMAL_NO_LIMIT THERMAL_NO_LIMIT>, <&cpu3 THERMAL_NO_LIMIT THERMAL_NO_LIMIT>;
		};
	};
};

&{/thermal-zones/cpu0-3-btm-thermal} {
	trips {
		cpu0_3_btm_alert: trip-point0 {
			temperature = <95000>;
			hysteresis = <2000>;
			type = "passive";
		};
	};

	cooling-maps {
		map0 {
			trip = <&cpu0_3_btm_alert>;
			cooling-device = <&cpu0 THERMAL_NO_LIMIT THERMAL_NO_LIMIT>, <&cpu1 THERMAL_NO_LIMIT THERMAL_NO_LIMIT>, <&cpu2 THERMAL_NO_LIMIT THERMAL_NO_LIMIT>, <&cpu3 THERMAL_NO_LIMIT THERMAL_NO_LIMIT>;
		};
	};
};

&{/thermal-zones/cpu1-0-top-thermal} {
	trips {
		cpu1_0_top_alert: trip-point0 {
			temperature = <95000>;
			hysteresis = <2000>;
			type = "passive";
		};
	};

	cooling-maps {
		map0 {
			trip = <&cpu1_0_top_alert>;
			cooling-device = <&cpu4 THERMAL_NO_LIMIT THERMAL_NO_LIMIT>, <&cpu5 THERMAL_NO_LIMIT THERMAL_NO_LIMIT>, <&cpu6 THERMAL_NO_LIMIT THERMAL_NO_LIMIT>, <&cpu7 THERMAL_NO_LIMIT THERMAL_NO_LIMIT>;
		};
	};
};

&{/thermal-zones/cpu1-0-btm-thermal} {
	trips {
		cpu1_0_btm_alert: trip-point0 {
			temperature = <95000>;
			hysteresis = <2000>;
			type = "passive";
		};
	};

	cooling-maps {
		map0 {
			trip = <&cpu1_0_btm_alert>;
			cooling-device = <&cpu4 THERMAL_NO_LIMIT THERMAL_NO_LIMIT>, <&cpu5 THERMAL_NO_LIMIT THERMAL_NO_LIMIT>, <&cpu6 THERMAL_NO_LIMIT THERMAL_NO_LIMIT>, <&cpu7 THERMAL_NO_LIMIT THERMAL_NO_LIMIT>;
		};
	};
};

&{/thermal-zones/cpu1-1-top-thermal} {
	trips {
		cpu1_1_top_alert: trip-point0 {
			temperature = <95000>;
			hysteresis = <2000>;
			type = "passive";
		};
	};

	cooling-maps {
		map0 {
			trip = <&cpu1_1_top_alert>;
			cooling-device = <&cpu4 THERMAL_NO_LIMIT THERMAL_NO_LIMIT>, <&cpu5 THERMAL_NO_LIMIT THERMAL_NO_LIMIT>, <&cpu6 THERMAL_NO_LIMIT THERMAL_NO_LIMIT>, <&cpu7 THERMAL_NO_LIMIT THERMAL_NO_LIMIT>;
		};
	};
};

&{/thermal-zones/cpu1-1-btm-thermal} {
	trips {
		cpu1_1_btm_alert: trip-point0 {
			temperature = <95000>;
			hysteresis = <2000>;
			type = "passive";
		};
	};

	cooling-maps {
		map0 {
			trip = <&cpu1_1_btm_alert>;
			cooling-device = <&cpu4 THERMAL_NO_LIMIT THERMAL_NO_LIMIT>, <&cpu5 THERMAL_NO_LIMIT THERMAL_NO_LIMIT>, <&cpu6 THERMAL_NO_LIMIT THERMAL_NO_LIMIT>, <&cpu7 THERMAL_NO_LIMIT THERMAL_NO_LIMIT>;
		};
	};
};

&{/thermal-zones/cpu1-2-top-thermal} {
	trips {
		cpu1_2_top_alert: trip-point0 {
			temperature = <95000>;
			hysteresis = <2000>;
			type = "passive";
		};
	};

	cooling-maps {
		map0 {
			trip = <&cpu1_2_top_alert>;
			cooling-device = <&cpu4 THERMAL_NO_LIMIT THERMAL_NO_LIMIT>, <&cpu5 THERMAL_NO_LIMIT THERMAL_NO_LIMIT>, <&cpu6 THERMAL_NO_LIMIT THERMAL_NO_LIMIT>, <&cpu7 THERMAL_NO_LIMIT THERMAL_NO_LIMIT>;
		};
	};
};

&{/thermal-zones/cpu1-2-btm-thermal} {
	trips {
		cpu1_2_btm_alert: trip-point0 {
			temperature = <95000>;
			hysteresis = <2000>;
			type = "passive";
		};
	};

	cooling-maps {
		map0 {
			trip = <&cpu1_2_btm_alert>;
			cooling-device = <&cpu4 THERMAL_NO_LIMIT THERMAL_NO_LIMIT>, <&cpu5 THERMAL_NO_LIMIT THERMAL_NO_LIMIT>, <&cpu6 THERMAL_NO_LIMIT THERMAL_NO_LIMIT>, <&cpu7 THERMAL_NO_LIMIT THERMAL_NO_LIMIT>;
		};
	};
};

&{/thermal-zones/cpu1-3-top-thermal} {
	trips {
		cpu1_3_top_alert: trip-point0 {
			temperature = <95000>;
			hysteresis = <2000>;
			type = "passive";
		};
	};

	cooling-maps {
		map0 {
			trip = <&cpu1_3_top_alert>;
			cooling-device = <&cpu4 THERMAL_NO_LIMIT THERMAL_NO_LIMIT>, <&cpu5 THERMAL_NO_LIMIT THERMAL_NO_LIMIT>, <&cpu6 THERMAL_NO_LIMIT THERMAL_NO_LIMIT>, <&cpu7 THERMAL_NO_LIMIT THERMAL_NO_LIMIT>;
		};
	};
};

&{/thermal-zones/cpu1-3-btm-thermal} {
	trips {
		cpu1_3_btm_alert: trip-point0 {
			temperature = <95000>;
			hysteresis = <2000>;
			type = "passive";
		};
	};

	cooling-maps {
		map0 {
			trip = <&cpu1_3_btm_alert>;
			cooling-device = <&cpu4 THERMAL_NO_LIMIT THERMAL_NO_LIMIT>, <&cpu5 THERMAL_NO_LIMIT THERMAL_NO_LIMIT>, <&cpu6 THERMAL_NO_LIMIT THERMAL_NO_LIMIT>, <&cpu7 THERMAL_NO_LIMIT THERMAL_NO_LIMIT>;
		};
	};
};

&{/thermal-zones/cpuss0-top-thermal} {
	trips {
		cpuss0_top_alert: trip-point0 {
			temperature = <95000>;
			hysteresis = <2000>;
			type = "passive";
		};
	};

	cooling-maps {
		map0 {
			trip = <&cpuss0_top_alert>;
			cooling-device = <&cpu0 THERMAL_NO_LIMIT THERMAL_NO_LIMIT>, <&cpu1 THERMAL_NO_LIMIT THERMAL_NO_LIMIT>, <&cpu2 THERMAL_NO_LIMIT THERMAL_NO_LIMIT>, <&cpu3 THERMAL_NO_LIMIT THERMAL_NO_LIMIT>;
		};
	};
};

&{/thermal-zones/cpuss0-btm-thermal} {
	trips {
		cpuss0_btm_alert: trip-point0 {
			temperature = <95000>;
			hysteresis = <2000>;
			type = "passive";
		};
	};

	cooling-maps {
		map0 {
			trip = <&cpuss0_btm_alert>;
			cooling-device = <&cpu0 THERMAL_NO_LIMIT THERMAL_NO_LIMIT>, <&cpu1 THERMAL_NO_LIMIT THERMAL_NO_LIMIT>, <&cpu2 THERMAL_NO_LIMIT THERMAL_NO_LIMIT>, <&cpu3 THERMAL_NO_LIMIT THERMAL_NO_LIMIT>;
		};
	};
};

&{/thermal-zones/cpuss1-top-thermal} {
	trips {
		cpuss1_top_alert: trip-point0 {
			temperature = <95000>;
			hysteresis = <2000>;
			type = "passive";
		};
	};

	cooling-maps {
		map0 {
			trip = <&cpuss1_top_alert>;
			cooling-device = <&cpu4 THERMAL_NO_LIMIT THERMAL_NO_LIMIT>, <&cpu5 THERMAL_NO_LIMIT THERMAL_NO_LIMIT>, <&cpu6 THERMAL_NO_LIMIT THERMAL_NO_LIMIT>, <&cpu7 THERMAL_NO_LIMIT THERMAL_NO_LIMIT>;
		};
	};
};

&{/thermal-zones/cpuss1-btm-thermal} {
	trips {
		cpuss1_btm_alert: trip-point0 {
			temperature = <95000>;
			hysteresis = <2000>;
			type = "passive";
		};
	};

	cooling-maps {
		map0 {
			trip = <&cpuss1_btm_alert>;
			cooling-device = <&cpu4 THERMAL_NO_LIMIT THERMAL_NO_LIMIT>, <&cpu5 THERMAL_NO_LIMIT THERMAL_NO_LIMIT>, <&cpu6 THERMAL_NO_LIMIT THERMAL_NO_LIMIT>, <&cpu7 THERMAL_NO_LIMIT THERMAL_NO_LIMIT>;
		};
	};
};

&lpass_wsa2macro {
	status = "disabled";
};

/*
 * Type-C / charger I2C. The firmware's EMEC device (SAM0604) puts a PD
 * controller (S2MM006) at 0x33 on i2c9 and i2c15 and the ISL9241 charger plus
 * the SBS battery at 0x09/0x0b on i2c20. The EC does not drive charging on
 * this board; userspace (book4-pd-charge) does, over these buses.
 */
&i2c9 {
	clock-frequency = <400000>;
	status = "okay";
};

&i2c15 {
	clock-frequency = <400000>;
	status = "okay";
};

&i2c20 {
	clock-frequency = <100000>;
	status = "okay";
};

/*
 * Camera. The SoC dtsi binds qcom,x1e80100-camcc, which on X1P42100 sets the
 * csiphy timer, csid, cphy_rx and ife_0 clocks to rates the silicon does not
 * have; the CSIPHY settle count derives from the timer rate and the D-PHY never
 * completes HS settle.
 */
&camcc {
	compatible = "qcom,x1p42100-camcc";
	assigned-clocks = <&camcc CAM_CC_CCI_0_CLK_SRC>,
			  <&camcc CAM_CC_CCI_1_CLK_SRC>,
			  <&camcc CAM_CC_SLOW_AHB_CLK_SRC>,
			  <&camcc CAM_CC_IFE_LITE_CLK_SRC>,
			  <&camcc CAM_CC_IFE_LITE_CSID_CLK_SRC>,
			  <&camcc CAM_CC_CPHY_RX_CLK_SRC>;
	assigned-clock-rates = <37500000>,
			       <37500000>,
			       <80000000>,
			       <400000000>,
			       <400000000>,
			       <400000000>;
};

/*
 * X1P42100 has one IFE, but camss has no x1p42100 resource table and brings up
 * two, so vfe1 defers forever. Alias vfe1 onto IFE0; nothing streams on it.
 */
&camss {
	clocks = <&camcc CAM_CC_CAMNOC_AXI_NRT_CLK>,
		 <&camcc CAM_CC_CAMNOC_AXI_RT_CLK>,
		 <&camcc CAM_CC_CORE_AHB_CLK>,
		 <&camcc CAM_CC_CPAS_AHB_CLK>,
		 <&camcc CAM_CC_CPAS_FAST_AHB_CLK>,
		 <&camcc CAM_CC_CPAS_IFE_0_CLK>,
		 <&camcc CAM_CC_CPAS_IFE_0_CLK>,
		 <&camcc CAM_CC_CPAS_IFE_LITE_CLK>,
		 <&camcc CAM_CC_CPHY_RX_CLK_SRC>,
		 <&camcc CAM_CC_CSID_CLK>,
		 <&camcc CAM_CC_CSID_CSIPHY_RX_CLK>,
		 <&gcc GCC_CAMERA_HF_AXI_CLK>,
		 <&gcc GCC_CAMERA_SF_AXI_CLK>,
		 <&camcc CAM_CC_IFE_0_CLK>,
		 <&camcc CAM_CC_IFE_0_FAST_AHB_CLK>,
		 <&camcc CAM_CC_IFE_0_CLK>,
		 <&camcc CAM_CC_IFE_0_FAST_AHB_CLK>,
		 <&camcc CAM_CC_IFE_LITE_CLK>,
		 <&camcc CAM_CC_IFE_LITE_AHB_CLK>,
		 <&camcc CAM_CC_IFE_LITE_CPHY_RX_CLK>,
		 <&camcc CAM_CC_IFE_LITE_CSID_CLK>;

	power-domains = <&camcc CAM_CC_IFE_0_GDSC>,
			<&camcc CAM_CC_IFE_0_GDSC>,
			<&camcc CAM_CC_TITAN_TOP_GDSC>;

	status = "okay";

	ports {
		/* The sensor is on CSIPHY0. CSIPHY1/2 read HW version 0 on this die. */
		port@0 {
			csiphy0_ep: endpoint@4 {
				reg = <4>;
				clock-lanes = <7>;
				data-lanes = <0 1>;
				remote-endpoint = <&ov02c10_ep>;
			};
		};
	};
};

/* The SoC dtsi gives csiphy0/1/2 no analog rails; without them the PHY runs unpowered. */
&csiphy0 {
	vdda-0p8-supply = <&vreg_l2c_0p8>;
	vdda-1p2-supply = <&vreg_l1c_1p2>;
	status = "okay";
};

&csiphy4 {
	vdda-0p8-supply = <&vreg_l2c_0p8>;
	vdda-1p2-supply = <&vreg_l1c_1p2>;
	phy-type = <PHY_TYPE_DPHY>;
	status = "okay";
};

&cci0 {
	status = "okay";
};

&cci0_i2c0 {
	clock-frequency = <100000>;

	camera@36 {
		compatible = "ovti,ov02c10";
		reg = <0x36>;

		reset-gpios = <&tlmm 109 GPIO_ACTIVE_LOW>;
		pinctrl-0 = <&cam_rgb_default>;
		pinctrl-names = "default";

		clocks = <&camcc CAM_CC_MCLK4_CLK>;
		assigned-clocks = <&camcc CAM_CC_MCLK4_CLK>;
		assigned-clock-rates = <19200000>;

		avdd-supply = <&vreg_l7b_2p8>;
		dvdd-supply = <&vreg_l7b_2p8>;
		dovdd-supply = <&vreg_l10b_1p8>;

		orientation = <0>;
		/* module is mounted upside down; see the ov02c10 hflip patch */
		rotation = <180>;

		port {
			ov02c10_ep: endpoint {
				data-lanes = <1 2>;
				link-frequencies = /bits/ 64 <400000000>;
				remote-endpoint = <&csiphy0_ep>;
			};
		};
	};
};

&cci0_i2c1 {
	clock-frequency = <100000>;
};

&cci1_i2c0 {
	clock-frequency = <100000>;
};

&cci1_i2c1 {
	clock-frequency = <100000>;
};

&tlmm {
	/*
	 * gpio96/gpio99 power the sensor; do not mux them to cam_mclk or it stops
	 * answering I2C. MCLK4 is gpio100 (cam_aon).
	 */
	cam-vdd-en-96-hog {
		gpio-hog;
		gpios = <96 GPIO_ACTIVE_HIGH>;
		output-high;
		line-name = "cam-vdd-en-96";
	};

	cam-vdd-en-99-hog {
		gpio-hog;
		gpios = <99 GPIO_ACTIVE_HIGH>;
		output-high;
		line-name = "cam-vdd-en-99";
	};

	cam-shutter-hog {
		gpio-hog;
		gpios = <221 GPIO_ACTIVE_HIGH>;
		output-high;
		line-name = "cam-shutter-enable";
	};

	cam-enable-hog {
		gpio-hog;
		gpios = <225 GPIO_ACTIVE_HIGH>;
		output-high;
		line-name = "cam-enable";
	};

	cam_rgb_default: cam-rgb-default-state {
		mclk-pins {
			pins = "gpio100";
			function = "cam_aon";
			drive-strength = <16>;
			bias-disable;
		};

		reset-n-pins {
			pins = "gpio109";
			function = "gpio";
			drive-strength = <2>;
			bias-disable;
		};
	};
};
